#ifndef _SCREEN_H_
#define _SCREEN_H_

#include <U8g2lib.h>

#ifdef U8X8_HAVE_HW_SPI
#include <SPI.h>
#endif
#ifdef U8X8_HAVE_HW_I2C
#include <Wire.h>
#endif

const float MAX_CURSOR_ACC = 16;

#define SCREEN_WIDTH 128
#define SCREEN_HEIGHT 64

U8G2_SH1107_64X128_F_4W_HW_SPI u8g2(U8G2_R3, /* cs=*/ 14, /* dc=*/ 27, /* reset=*/ 33);

#define FONT u8g2_font_wqy12_t_gb2312


const uint8_t battery_7x12[118] U8G2_FONT_SECTION("battery_7x12") =
  "\5\0\4\4\4\3\1\1\5\14\7\0\0\7\0\0\0\0\0\0\0\0Y\60\15\374\71\254\10\31\42\344"
  ",C\254\0\61\22\374\71\254\10\31\42\272\21\341F\204\33\31b\5\0\62\22\374\71\254\10\31\42V#"
  "\242\32\21\325\310\20+\0\63\23\374\71\254\10\31\42nF\304fDlF\206X\1\0\64\23\374\71\254"
  "\10\31\42^\214\210\213\21q\61\62\304\12\0\0\0\0\4\377\377\0";

#define screen_bg_width 128
#define screen_bg_height 64
static const unsigned char screen_bg_bits[] U8X8_PROGMEM = {
  0x00, 0x00, 0x00, 0x00, 0x00, 0x00, 0x00, 0x00, 0x00, 0x00, 0x00, 0x00,
  0x00, 0x00, 0x00, 0x00, 0x38, 0x04, 0x0F, 0xFE, 0x03, 0x00, 0x00, 0x00,
  0x00, 0x00, 0x00, 0x80, 0x7B, 0x20, 0x00, 0x00, 0x44, 0xC4, 0x30, 0x06,
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  0x40, 0x00, 0x00, 0x00,
};


void drawScreenBackground() {
  uint8_t transparent = 0;
  if (!transparent) {
    u8g2.setBitmapMode(false /* solid */);
    u8g2.drawStr(0, 0, "Solid bitmap");
  } else {
    u8g2.setBitmapMode(true /* transparent*/);
    u8g2.drawStr(0, 0, "Transparent bitmap");
  }
  u8g2.setDrawColor(1); // White
  // u8g2.setDrawColor(0);// Black
  u8g2.drawXBMP(0, 0, screen_bg_width, screen_bg_height, screen_bg_bits);
  //  u8g2.drawXBMP(frame_size * 2, 24, cross_width, cross_height, cross_bits);
  //  u8g2.setDrawColor(2); // XOR
  //  u8g2.drawXBMP(frame_size * 3.5, 24, cross_width, cross_height, cross_bits);
}


void showSplashScreen() {
  u8g2.clearBuffer();
  u8g2.drawStr(10, 20, "LOADING...");
  u8g2.sendBuffer();
}

void showConnectingWifi() {
  u8g2.clearBuffer();
  u8g2.drawStr(10, 20, "CONNECTING WIFI...");
  u8g2.sendBuffer();
}

void showWifiConnected() {
  u8g2.clearBuffer();
  u8g2.drawStr(10, 20, "WIFI CONNECTED, NTP..");
  u8g2.sendBuffer();
}

void drawCursor() {
  int cursor_x = SCREEN_WIDTH / 2 + (int)(SCREEN_WIDTH / 2 * (IMU.roll / MAX_CURSOR_ACC));
  int cursor_y = SCREEN_HEIGHT / 2 - (int)(SCREEN_HEIGHT / 2 * (IMU.pitch / MAX_CURSOR_ACC));
  if (cursor_x < 0 ) {
    cursor_x = 0;
  }
  if (cursor_x >= SCREEN_WIDTH) {
    cursor_x = SCREEN_WIDTH - 1;
  }
  if (cursor_y < 0) {
    cursor_y = 0;
  }
  if (cursor_y >= SCREEN_HEIGHT - 1) {
    cursor_y = SCREEN_HEIGHT - 2;
  }
  u8g2.drawTriangle(cursor_x, cursor_y, cursor_x, cursor_y + 9, cursor_x + 6, cursor_y + 6);
  u8g2.drawLine(cursor_x + 2, cursor_y + 3, cursor_x + 4, cursor_y + 11);
}


void drawTime() {
  struct tm timeinfo;
  if (!getLocalTime(&timeinfo)) {
    Serial.println("Failed to get local time, should not be here?");
  } else {
    char dateStringBuff[50]; //50 chars should be enough
    char timeStringBuff[50]; //50 chars should be enough
    char weekDayBuff[5]; //5 chars should be enough
    strftime(dateStringBuff, sizeof(dateStringBuff), "%Y-%m-%d", &timeinfo);
    strftime(weekDayBuff, sizeof(weekDayBuff), "%a", &timeinfo);
    strftime(timeStringBuff, sizeof(timeStringBuff), "%H:%M:%S", &timeinfo);
    // u8g2.setFont(u8g2_font_5x8_tf);
    u8g2.drawStr(15, 11, dateStringBuff);
    u8g2.drawStr(77, 11, weekDayBuff);
    u8g2.drawStr(40, 0, timeStringBuff);
  }
}

void drawSleepText() {
  u8g2.clearBuffer();
  u8g2.drawStr(10, 30, "Deep sleep now...");
  u8g2.sendBuffer();
}

void drawHelloStickWatch() {
  u8g2.drawStr(6, 6, "Hello,");
  u8g2.drawStr(6, 16, "DIY Stick Watch!");
  u8g2.drawStr(70, 1, reason);
}

uint8_t battery_index = 0;
unsigned int battery_ui_update_time = 0;

void drawBatteryStatusWithFont(bool isCharging, bool isChargeFull) {
  u8g2.setFont(battery_7x12);
  char * batteryIndexStr;
  if (isCharging) {
    // animation speed control
    unsigned long now = millis();
    if (now - battery_ui_update_time > 250) {
      battery_ui_update_time = now;
      battery_index++;
      if (battery_index > 4) {
        battery_index = 0;
      }
    }
    switch (battery_index) {
      case 0: batteryIndexStr = "0"; break;
      case 1: batteryIndexStr = "1"; break;
      case 2: batteryIndexStr = "2"; break;
      case 3: batteryIndexStr = "3"; break;
      case 4: batteryIndexStr = "4"; break;
      default: batteryIndexStr = "4"; break;
    }
  } else {
    batteryIndexStr = "3";
  }
  u8g2.drawStr(115, 0, batteryIndexStr);
  u8g2.setFont(u8g2_font_6x10_mf);
}

void drawBatteryStatus(bool isCharging, bool isChargeFull) {
  u8g2.setFont(u8g2_font_wqy12_t_gb2312);
  // u8g2.setFont(u8g2_font_5x7_mf);
  if (isCharging) {
    u8g2.drawUTF8(1, 51, "充电中/");
  } else {
    u8g2.drawUTF8(1, 51, "未充电/");
  }
  if (isChargeFull) {
    u8g2.drawUTF8(42, 51, "充满了!");
  } else {
    u8g2.drawUTF8(42, 51, "未充满");
  }
  u8g2.setFont(u8g2_font_6x10_mf);
}

void screenOffAnimation() {
  for (int i = 0; i < 32; i++) {
    u8g2.clearBuffer();
    u8g2.drawLine(0, i, 128, i);
    u8g2.drawLine(0, 64 - i, 128, 64 - i);
    u8g2.sendBuffer();
    delay(3);
  }
}

void drawChipTemprature(int temp_farenheit) {
  float temp_celsius = ( temp_farenheit - 32 ) / 1.8;
  char sensor_buf[64];
  sprintf(sensor_buf, "%.1fC", temp_celsius);
  u8g2.drawStr(98, 35, sensor_buf);
}

#endif // _SCREEN_H_
